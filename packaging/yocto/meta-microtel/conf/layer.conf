## packaging/yocto/meta-microtel/conf/layer.conf
```bitbake
# meta-microtel: Yocto/OpenEmbedded layer for microtel.
BBPATH .= ":${LAYERDIR}"

BBFILES += "${LAYERDIR}/recipes-*/*/*.bb \
            ${LAYERDIR}/recipes-*/*/*.bbappend"

BBFILE_COLLECTIONS += "microtel"
BBFILE_PATTERN_microtel = "^${LAYERDIR}/"
BBFILE_PRIORITY_microtel = "6"

LAYERVERSION_microtel = "1"
LAYERDEPENDS_microtel = "core"
LAYERSERIES_COMPAT_microtel = "scarthgap styhead walnascar whinlatch"
```
